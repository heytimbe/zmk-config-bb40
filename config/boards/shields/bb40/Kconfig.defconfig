## config/boards/shields/bb40/Kconfig.defconfig
```kconfig
# Copyright (c) 2022 The ZMK Contributors
# SPDX-License-Identifier: MIT

if SHIELD_BB40

config ZMK_KEYBOARD_NAME
    default "bb40"

endif
```

## config/boards/shields/bb40/Kconfig.shield
```kconfig
# Copyright (c) 2022 The ZMK Contributors
# SPDX-License-Identifier: MIT

config SHIELD_bb40
    def_bool $(shields_list_contains,bb40)
```

## config/west.yml
```yaml
manifest:
  remotes:
    - name: elpekenin
      url-base: https://github.com/elpekenin
    - name: zmkfirmware
      url-base: https://github.com/zmkfirmware
  projects:
    - name: zmk-userspace
      remote: elpekenin
      revision: main
      remote: elpekenin
      revision: main
    - name: zmk
      remote: zmkfirmware
      revision: main
      import: app/west.yml
      self:
    path: config
```
